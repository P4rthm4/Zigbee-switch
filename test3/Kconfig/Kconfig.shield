## test3/Kconfig/Kconfig.shield
```kconfig
osource "c:/users/user/onedrive/desktop/nrf_dongle/light_switch_1/boards/shields/*/Kconfig.shield"
osource "C:/nRC-SDK/v2.4.2/nrf/boards/shields/*/Kconfig.shield"
```

## test3/Kconfig/Kconfig.shield.defconfig
```kconfig
osource "c:/users/user/onedrive/desktop/nrf_dongle/light_switch_1/boards/shields/*/Kconfig.defconfig"
osource "C:/nRC-SDK/v2.4.2/nrf/boards/shields/*/Kconfig.defconfig"
```
